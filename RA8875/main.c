#include <string.h>
#include <math.h>
#include "ht32.h"
#include "ht32_board.h"
#include "sdio_sd.c"
#include "./FatFS/tff.h"
#include "RA8875.h"
#include "Keypad.h"
#include "DisplayDefs.h"
#include "TimerManager.h"
#include "common/MX25L512.h"

#if 0
u8 rabit[1500] =
{
	0XFF,0XFF,0XFF,0XFF,0XFF,0XFF,0XFF,0XFF,0XFF,0XFF,0XFF,0XFF,0XFF,0XFF,0XFF,0XFF,
	0X00,0X00,0X00,0X00,0X00,0X00,0X00,0X00,0X00,0X00,0X00,0X00,0X00,0X00,0X00,0X00,
	0X00,0X00,0X00,0X00,0X00,0X00,0X00,0X00,0X00,0X00,0X00,0X00,0X00,0X00,0X00,0X00,
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	0X00,0X00,0X00,0X00,0X00,0X00,0X00,0X00,0X00,0X00,0X00,0X00,
};


#endif

u8				gImage_p16x16_2[512] =
{ /* 0X10,0X10,0X00,0X10,0X00,0X10,0X01,0X1B, */

	0XFF,0XBF,0XFF,0X9F,0XFF,0XFC,0XFF,0XD7,0XFF,0XD1,0XF6,0XE9,0XFF,0X46,0XFE,0XE3,
	0XFF,0X03,0XFF,0X24,0XFF,0X27,0XFF,0XF0,0XFF,0XB5,0XFF,0XBA,0XFF,0XBF,0XFF,0X9F,
	0XFF,0XBF,0XFF,0XFD,0XFF,0X56,0XF7,0X30,0XFF,0X4D,0XFF,0X29,0XF6,0XC6,0XFF,0X89,
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	0XE5,0X40,0XED,0X82,0XD5,0X23,0XFF,0XB1,0XFF,0XF7,0XFF,0X7A,0XFF,0XFF,0XFF,0XDF,
};


u8				tick = 0;
bool			click = FALSE;
u32 			uSpeedCount;

/* Global variables ----------------------------------------------------------------------------------------*/
FATFS			fs; /* File system object																	*/
FIL 			fsrc; /* File object																		*/
DIR 			dir; /* Directory object																	*/
FILINFO 		fno; /* File info object																	*/
UINT			dcnt = 0;
FRESULT 		result = FR_NOT_READY;
u8				SD_ReadBuf[51200]; //2017/09/25

void EX1( void );
void BTE_Ex3( void );
void BTE_Ex1( void );
void BTE_SMILE( void );
void BTE_Example2( void );

const unsigned char bw[2048] =
{
	0x00,0x00,0x00,0x00,0x00,0x00,0x00,0x00,0x04,0x00,
	0x00,0x00,0x00,0x00,0x00,0x00,0x00,0x00,0x00,0x00,
	0x00,0x00,0x00,0x00,0x0c,0x00,0x00,0x00,0x00,0x00,
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	0xff,0xe0,0x00,0x00,0x00,0x00,0x00,0x00,
};


u8 mBuff2[256] = "test";

// Define a keyboard layout as a calculator-like keypad
// 789 /(
// 456 *)
// 123 -
// 00. +=
const char numberkeys[] =
{
    5,0x01, 10,'7',10,'8',10,'9', 5,0x01, 10,'/',10,'(', 0,0,
    5,0x01, 10,'4',10,'5',10,'6', 5,0x01, 10,'*',10,')', 0,0,
    5,0x01, 10,'1',10,'2',10,'3', 5,0x01, 10,'-',10,KYBD_SYM_BS, 0,0,
    5,0x01, 20,'0',       10,'.', 5,0x01, 10,'+',10,'=', 0,0,
    0,0
};

// Define the implementation of that keyboard
const keyboard_t altkeyboard =
{
    100,        // x=100; left edge
    0,          // y=0; computed from bottom up
    240,        // width=240
    0,          // height=0; bottom of screen justified
    4,          // rows
    6,          // columns
    numberkeys, // pointer to the keypad
    numberkeys
};


_KEYPAD *kp;
_RA8875 *lcd;


void CalibrateTS(void)
{
    // FIL *fh;
    tpMatrix_t matrix;
    RetCode_t r;

    r = lcd->TouchPanelCalibrate( "\r\nCalibrate the touch panel", &matrix, 1 );

    if ( r == noerror )
    {
    	/*
        fh = fopen("/local/tpcal.cfg", "wb");

        if ( fh )
        {
            fwrite(&matrix, sizeof(tpMatrix_t), 1, fh);
            fclose(fh);
        }
        else
        {
            lcd.printf( "Cannot save calibration in /local/tpcal.cfg\r\n" );
            wait_ms(1000);
        }
        */
    }
    else
    {
        lcd->printf( "\r\nTouchPanelCalibrate returned error code %d", r );

       	wait_ms( 2000 );
    }

}

void FloatingSmallQWERTYTest( loc_t x, loc_t y, dim_t w, dim_t h )
{
    keyboard_t tiny;

    char name1[ 20 ];

    kp->SetKeyboard( NULL, KYBD_SYM_ENTER, KYBD_SYM_ESCAPE );

    memcpy( &tiny, kp->GetKeyboard( ), sizeof( keyboard_t ) );

	tiny.x = x;
	tiny.y = y;
    tiny.width = w;
    tiny.height=h;

    printf( "\r\nFloatingSmallQWERTYTest" );

    // copy definition and then resize it
    // select the internal keyboard
    // now select this tiny keyboard
    kp->SetKeyboard( &tiny, KYBD_SYM_ENTER, KYBD_SYM_ESCAPE );

    kp->SetKeyboardFont( 0, 4 );

    if ( kp->GetString( name1, sizeof( name1 ), "", FALSE, 0, FALSE ) )
    {
    	/*
        LCD.foreground(BrightRed);
        lcd.background(Black);
        lcd.cls();
        lcd.SetTextCursor(0,40);
        lcd.printf("Compressed: %s\r\n", name1);
        */
    }
}

void CalculatorKeypadTest(void)
{
    char name1[20];

    kp->SetKeyboard( &altkeyboard, '=', 0 );
    kp->SetKeyboardFont( 0, 4 );

    if( kp->GetString( name1, sizeof( name1 ), "Calc:", FALSE, 0, FALSE ) )
    {
    	/*
        lcd.foreground(BrightRed);
        lcd.background(Black);
        lcd.cls();
        lcd.SetTextCursor(0,40);

        lcd.printf( "Calculator: %s\r\n", name1 );
        */
    }
}


int main( void )
{
	// int i = 0;
	// u8	tStr[ ] = "";
	// u8	tStr2[ 9 ] = "";
	// u16 temp;
	// u16 temp_result;
	u8	lsd,msd;
	// int second;
	rect_t r;

	RETARGET_Configuration( );						//Retarget Related configuration
	printf( "\r\n========== Initial ==========" );

	HT32F_DVB_LEDInit( HT_LED1 );

	NVIC_EnableIRQ( SDIO_IRQn );
	NVIC_EnableIRQ( PDMACH6_IRQn ); 					  // SDIO_RX
	NVIC_EnableIRQ( PDMACH7_IRQn ); 					  // SDIO_TX

	/* SYSTICK configuration */
  	SYSTICK_ClockSourceConfig( SYSTICK_SRC_STCLK );       // Default : CK_SYS/8
  	SYSTICK_SetReloadValue( SystemCoreClock / 8 / 1000 ); // (CK_SYS/8/1000) = 1ms on chip
  	SYSTICK_IntConfig( ENABLE );                          // Enable SYSTICK Interrupt
  	SYSTICK_CounterCmd( SYSTICK_COUNTER_CLEAR );
	SYSTICK_CounterCmd( SYSTICK_COUNTER_ENABLE );
	// ---------------------------------------------

    #if 0
	AFIO_GPxConfig( GPIO_PC, AFIO_PIN_12, AFIO_FUN_GPIO );
	GPIO_DirectionConfig( HT_GPIOC, AFIO_PIN_12, GPIO_DIR_OUT );

	while( 1 )
	{
		wait_ms( 1000 );

		GPIO_WriteOutBits( HT_GPIOC, AFIO_PIN_12,SET );

		// HT32F_DVB_LEDToggle( HT_LED1 );

		wait_ms( 1000 );

		GPIO_WriteOutBits( HT_GPIOC, AFIO_PIN_12,0 );
	}
    #endif

	wait_ms( 500 );

    LCD_Init( );
    LCD_Config( );

    EBI_SRAM_Init( );
    EBI_SRAM_Test( );
   	EBI_SRAM_Test_1( );

	kp = Keypad_CreateObj( Black, Gray );
	lcd = RA8875_CreateObj( );

	// I2C_EEPROM_Init( );

	/* Initialize the SPI_FLASH driver */
  	result = SPI_FLASH_Init();

  	printf( "\r\n%d = SPI_FLASH_Init( )", result );

  	MX25L512_Test( );

	f_mount( 0, &fs );

	// lcd->foreground( Yellow );
    // lcd->background( Black );

	// CalculatorKeypadTest( );
	// ---------------------------------------

	// DrawPictureFromSD( "file1.dat", SD_ReadBuf, 100, 0 );

    // DrawPictureFromSD( "meter.dat", SD_ReadBuf, 150, 100 );

    // DrawPictureFromSD( "test.dat", SD_ReadBuf, 500, 100 );

    // DrawPictureFromSD( "file1.dat", SD_ReadBuf, 200, 100 );

    // printf( "\r\nLCD_Init();" );
    // printf( "\r\nHT_EBI->CR 0x%x", HT_EBI->CR );

	// CalibrateTS();

	/*
	Graphic_Mode( );
	lcd->clsw( FULLWINDOW );
	r.p1.x = 0;
	r.p1.y = 0;
	r.p2.x = 800;
	r.p2.y = 480;
	lcd->fillrect( r, Gray, FILL );
	*/

	// FloatingSmallQWERTYTest( 30, 50, 725, 0 );

	// printf( "\r\nLCD_Init;" );
	// printf( "\r\nHT_EBI->CR 0x%x", HT_EBI->CR );

	Graphic_Mode( );
	Write_Dir( 0x8E, 0x80 ); 	//Clean
	CmdWrite( 0x02 );
	openBMP3( "bg.dat" );

	// FloatingSmallQWERTYTest( 30, 50, 725, 0 );

	/*
	DrawString(10,20,tStr2,0,0,FALSE,FALSE,Green,Red);
	DrawString(10,40,tStr2,1,1,FALSE,FALSE,Green,Red);
	DrawString(10,80,tStr2,2,2,FALSE,FALSE,Green,Red);

	DrawString(180,20,tStr2,0,0,FALSE,FALSE,Red,Black);
	DrawString(180,40,tStr2,1,1,FALSE,FALSE,Red,Black);
	DrawString(180,80,tStr2,2,2,FALSE,FALSE,Red,Black);

	DrawString(350,20,tStr2,0,3,FALSE,TRUE,Red,White);
	DrawString(350,40,tStr2,1,3,FALSE,TRUE,Red,White);
	DrawString(350,80,tStr2,2,3,FALSE,TRUE,Red,White);

	DrawRect(350,200,450,300,Red,Blue,TRUE);
	DrawRect(650,200,750,300,Red,Green,FALSE);
	DrawLine(50,250,50,250,Red,Yellow);
	DrawLine(250,450,250,50,Red,Green);
	DrawTri(400,500,600,400,450,400,Red,Purple,TRUE);
	DrawTri(100,200,300,400,450,400,Red,Purple,FALSE);
	DrawEllipse(50,300,30,50,White,Red,FALSE);
	DrawEllipse(150,300,30,50,White,Red,TRUE);

	DrawCircle(550,240,60,White,Red,TRUE);
	DrawCircle(400,240,60,White,Green,FALSE);

	DrawRoundRect(450,500,50,100,0,0,15,15,White,Red,FALSE);
	DrawRoundRect(450,500,120,170,0,0,10,10,White,Red,TRUE);

	DrawCurve(600,60,30,30,1,White,Yellow,FALSE);
	DrawCurve(680,60,30,15,1,White,Red,TRUE);

	DrawCurve(680,60,30,15,1,White,White,TRUE);
	DrawCurve(680,60,30,15,2,White,Blue,TRUE);
	DrawCurve(680,60,30,15,3,White,Yellow,TRUE);
	DrawCurve(680,60,30,15,4,White,Green,TRUE);
	Chk_Busy();

		//Write_Dir(0x10,0x0F);//16Bit

		Write_Dir(0x10,0x0c);//8Bit
		//Chk_Busy();

		//Write_Dir(0x10,0x0F);//16Bit
		Foreground_Color(Red);
		Background_color(Green);
		BTE_Source_Destination(0,250,0,250);
		BTE_Size_setting(120,100);
		BTE_ROP_Code(0x79);	//	set BTE color expansion with transparency
		//BTE_ROP_Code(0xF9);
		BTE_enable();
		CmdWrite(0x02);//MRWC

		//for(i=0;i<750;i++){
		//	temp = rabit[i*2];
		//	temp<<=8;
		//	temp&=0xff00;
		//	temp= temp | rabit[i*2+1];
		//	DataWrite(temp);
		//	Chk_Busy();
		//}
		for(i=0;i<1500;i++){
			DataWrite(rabit[i]);
			Chk_Busy();
		}
		//Chk_Busy();

		Chk_Busy_BTE();

		Write_Dir(0x10,0x0F);//16Bit
		Foreground_Color(Yellow);
		Background_color(Purple);
		BTE_Source_Destination(0,650,0,350);
		BTE_Size_setting(128,128);
		BTE_ROP_Code(0xF9); // set BTE color expansion
		BTE_enable();
		CmdWrite(0x02);//MRWC

	for(i=0;i<1024;i++)
	{
		temp = bw[i*2];
		temp<<=8;
		temp&=0xff00;
		temp= temp | bw[i*2+1];
		DataWrite(temp);
		Chk_Busy();
	}
	*/

	// Write_Dir(0x10,0x0F);//16Bit
	// while(1){
	// Scroll(10,80,10,80);
	// }

	/*

	CmdWrite(0x02);
	Chk_Busy();

	*/

	// Write_Dir(0x8E,0x80);	// Clean
	// CmdWrite(0x02);			// MRWC

	printf( "\r\n=====Start=====" );

	// KeyBoard_Int( );

	while ( 1 )
	{
		Graphic_Mode( );
		lcd->clsw( FULLWINDOW );
		r.p1.x = 0;
		r.p1.y = 0;
		r.p2.x = 100;
		r.p2.y = 100;
		lcd->fillrect( r, Red, FILL );

		wait_ms( 1000 );

		EBI_SRAM_Test_1( );

		wait_ms( 1000 );

        Graphic_Mode( );
        Write_Dir( 0x8E, 0x80 ); 	//Clean
        CmdWrite( 0x02 );
        openBMP3( "bg.dat" );

        wait_ms( 1000 );

        EBI_SRAM_Test( );

		// I2C_EEPROM_BufferWrite(mBuff2,0,32);
		HT32F_DVB_LEDToggle( HT_LED1 );

		// I2C_BufferRead( mBuff2,0x68,0,8 );			//0x50

		// I2C_EEPROM_BufferRead(mBuff2,0, 8);
		// for(i=0;i<8;i++){
		//		printf("[0x%x],",mBuff2[i]);
		//}
		lsd 				= ( mBuff2[2] &0x0f );
		msd 				= ( mBuff2[2] &0x70 ) >> 4;

        #if 0
		tStr2[1]			= lsd + '0';
		tStr2[0]			= msd + '0';

		tStr2[2]			= ':';
		lsd 				= ( mBuff2[1] &0x0f );
		msd 				= ( mBuff2[1] &0x70 ) >> 4;
		tStr2[4]			= lsd + '0';
		tStr2[3]			= msd + '0';
		lsd 				= ( mBuff2[0] &0x0f );
		msd 				= ( mBuff2[0] &0x70 ) >> 4;
		tStr2[5]			= ':';
		tStr2[7]			= lsd + '0';
		tStr2[6]			= msd + '0';
		tStr2[8]			= '\0';
        #endif

		// printf("\r\n%s\r\n",tStr2);

		/*
		for(i=0;i<8;i++){
			if( i%8==7)
				printf("[0x%x]\r\n",mBuff2[i]);
			else
				printf("[0x%x],",mBuff2[i]);
		}
		*/

		// tStr2[0] = 0x31;
		// tStr2[1] = 0x32;
		// tStr2[2] = 0x33;
		// Chk_Busy();

		// DrawString( 300,200,tStr2,3,3,FALSE,FALSE,White,Red );

		// DrawString(10,300,mBuff2[i],0,0,FALSE,FALSE,Green,Purple);
		// DrawString(10,20,tStr2,0,0,FALSE,FALSE,Green,Red);
		printf( "\r\n=====End=====" );

		wait_ms( 1000 );
	}
}


void openBMP3( const char * filename )
{
	UINT			t	= 0,j = 0;
	UINT			dcnt = 0;

	result	= f_open( &fsrc,( const char * ) filename,FA_OPEN_EXISTING | FA_READ );

	if ( result == FR_OK )
	{
		// printf("[Read File OK]\r\n");
	}
	else
	{
		printf( "\r\nSD Card Read File Failed" );
	}

	for ( t = 0; t < 15; t++ )
	{
		result				= f_read( &fsrc,SD_ReadBuf,51200,&dcnt );

		for ( j = 0; j < 25600; j++ )
		{
			EBI_LCD->EBI_LCD_RAM = SD_ReadBuf[j * 2 + 0] << 8 | SD_ReadBuf[j * 2 + 1];
		}
	}

	f_close( &fsrc );
}


u16 ToColor( u8 data1,u8 data2 )
{
	return data1 << 8 | data2;
}


void BTE_Example2( void )
{
	int 			i	= 0;

	Pattern_Set_16x16();
	Write_To_Pattern();
	Pattern_Set_number( 0 );
	Graphic_Mode();
	CmdWrite( 0x02 );

	for ( i = 0; i < 256; i++ )
	{
		DataWrite( ToColor( gImage_p16x16_2[i * 2 + 0],gImage_p16x16_2[i * 2 + 1] ) );
		Chk_Busy();
	}

	Chk_Busy();
	Write_To_Bank1and2();
	Write_To_Bank1();
	BTE_Source_Destination( 0,0,0,20 );
	Source_Layer1();
	Destination_Layer1();
	BTE_Size_setting( 800,16 );
	BTE_ROP_Code( 0xc6 );
	BTE_enable();
	Chk_Busy_BTE();

}


